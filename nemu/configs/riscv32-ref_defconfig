## nemu/configs/riscv32-standalone-ref_defconfig
```kconfig
CONFIG_ISA_riscv=y
CONFIG_TARGET_SHARE=y
# CONFIG_TRACE is not set
CONFIG_MSIZE=0x8000000
CONFIG_DEVICE=y
```

## nemu/configs/riscv32-standalone_defconfig
```kconfig
CONFIG_ISA_riscv=y
# CONFIG_RV64 is not set
CONFIG_RVE=y
CONFIG_TARGET_SHARE=y
CONFIG_CC_OPT="-O2"
# CONFIG_TRACE is not set
CONFIG_MBASE=0x80000000
CONFIG_MSIZE=0x8000000
CONFIG_MEM_RANDOM=y
```

## nemu/configs/riscv32-ysyxsoc-ref_defconfig
```kconfig
CONFIG_ISA_riscv=y
CONFIG_TARGET_SHARE=y
# CONFIG_TRACE is not set
CONFIG_DEVICE=y
CONFIG_YSYXSOC=y
```

## nemu/configs/riscv32-ysyxsoc-so_defconfig
```kconfig
CONFIG_ISA_riscv=y
# CONFIG_RV64 is not set
CONFIG_RVE=y
CONFIG_TARGET_SHARE=y
CONFIG_CC_OPT="-O2"
# CONFIG_TRACE is not set
CONFIG_MEM_RANDOM=y
```

## nemu/configs/riscv32-ysyxsoc_defconfig
```kconfig
CONFIG_ISA_riscv=y
CONFIG_RVE=y
CONFIG_TARGET_NATIVE_ELF=y
CONFIG_CC_OPT="-O2"
CONFIG_DEVICE=y
CONFIG_HAS_SERIAL=y
CONFIG_SERIAL_MMIO=0x10000000
# CONFIG_HAS_TIMER is not set
# CONFIG_HAS_KEYBOARD is not set
# CONFIG_HAS_VGA is not set
# CONFIG_HAS_AUDIO is not set
# CONFIG_HAS_DISK is not set
# CONFIG_TRACE is not set
# CONFIG_MEM_RANDOM is not set
```
